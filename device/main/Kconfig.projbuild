## device/main/Kconfig.projbuild
```kconfig
menu "RS485 Interface Configuration"

    config RS485_UART_PORT_NUM
        int "RS485 UART port number"
        range 0 2 if IDF_TARGET_ESP32 || IDF_TARGET_ESP32S3
        default 2 if IDF_TARGET_ESP32 || IDF_TARGET_ESP32S3
        range 0 1
        default 1
        help
            UART port number for RS485 communication.
            Use UART2 on ESP32/ESP32-S3 to avoid conflict with console (UART0) and regular UART (UART1).

    config RS485_UART_TXD
        int "RS485 UART TXD pin number"
        range 0 48
        default 17
        help
            GPIO number for RS485 UART TX pin.
            See UART documentation for available pin numbers.

    config RS485_UART_RXD
        int "RS485 UART RXD pin number"
        range 0 48
        default 18
        help
            GPIO number for RS485 UART RX pin.
            See UART documentation for available pin numbers.

    config RS485_UART_RTS
        int "RS485 UART RTS pin number (DE/~RE control)"
        range -1 48
        default 10
        help
            GPIO number for UART RTS pin. This pin is connected to
            ~RE/DE pin of RS485 transceiver to switch direction.
            Set to -1 if your transceiver has auto-direction control.

    config RS485_READ_TIMEOUT
        int "RS485 read timeout (TOUT threshold)"
        range 1 127
        default 3
        help
            Timeout threshold for UART TOUT feature.
            Number of symbols (~10 ticks each) with unchanged state on receive pin.
            TOUT=3 corresponds to approximately 24-33 ticks (about 3.5 character times).
            This is important for proper Modbus packet detection.

    config RS485_RX_INVERT
        bool "Invert RS485 RX signal"
        default y
        help
            Enable RX signal inversion. This is commonly required with many RS485 transceivers.
            If you receive garbled data, try toggling this option.

    config RS485_DEFAULT_BAUD_RATE
        int "RS485 default baud rate"
        range 1200 921600
        default 9600
        help
            Default baud rate for RS485 communication if not specified by LwM2M object.

    config RS485_RX_BUFFER_SIZE
        int "RS485 RX buffer size"
        range 127 4096
        default 256
        help
            Size of the UART RX buffer for RS485 communication.

endmenu

menu "Interface Bridge Configuration"

    config IFACE_BRIDGE_HEX_DUMP_LOG
        bool "Enable interface bridge hex dump logs"
        default n
        help
            Enable verbose TX/RX hex dump logs in interface bridge drivers
            (I2C/UART/RS485). Keep disabled in production to reduce log volume
            and avoid leaking payload data over logs.

    config IFACE_OPEN_DELAY_WHEN_DISABLED_MS
        int "Interface open delay when disabled (ms)"
        range 0 5000
        default 500
        help
            Delay added after interface open succeeds while the interface
            enabled flag is false. Set to 0 to disable this delay.

endmenu

menu "Sampling Configuration"

    config SAMPLE_ENABLE_LUA_SCRIPT_DUMP
        bool "Enable Lua script dump logs"
        default n
        help
            Enable verbose Lua script content dump logs used for debugging
            script load/execute issues. Keep disabled in production to avoid
            exposing script content in logs.

    config SAMPLE_REPORT_READY_TIMEOUT_MS
        int "Report wait-for-LwM2M-ready timeout (ms)"
        range 1000 120000
        default 30000
        help
            When sampling in sleep-enabled modes and a report deadline is reached,
            the device waits this long for LwM2M/network readiness before skipping
            reporting for that cycle and returning to sleep.

endmenu

menu "LwM2M Configuration"
    config LWM2M_SERVER_URI
        string "Default LwM2M server URI"
        default ""
        help
            Default LwM2M server URI used when factory/bootstrap data does not
            provide an override. Example: coap://192.168.100.10:5683 or
            coaps://example.com:5684.

    config LWM2M_DEVICE_MANUFACTURER
        string "LwM2M device manufacturer"
        default "Open Mobile Alliance"
        help
            Device Object (ID 3) Manufacturer (Resource 0).

    config LWM2M_DEVICE_MODEL
        string "LwM2M device model"
        default "Lightweight M2M Client"
        help
            Device Object (ID 3) Model Number (Resource 1).

    config LWM2M_DEVICE_FIRMWARE_VERSION
        string "LwM2M device firmware version"
        default "1.0"
        help
            Device Object (ID 3) Firmware Version (Resource 3) default value.

endmenu

menu "HaLow Build Configuration"

    config ENABLE_MM_HALOW
        bool "Enable MM HaLow support"
        default y
        help
            Enable HaLow-related code paths and integration points.

    config MM_HALOW_COUNTRY_CODE
        string "HaLow country code"
        default "US"
        depends on ENABLE_MM_HALOW
        help
            Two-letter regulatory country code used for HaLow operation.

endmenu

menu "HaLow Mesh Experimental Configuration"

    config MM_EXPERIMENTAL_MESH
        bool "Enable experimental 802.11s mesh mode"
        default n
        depends on ENABLE_MM_HALOW
        help
            Enable experimental mesh mode parameters for HaLow connect flow.

if MM_EXPERIMENTAL_MESH

    config MM_EXPERIMENTAL_MESH_OP_CLASS
        int "Experimental mesh S1G operating class"
        range 1 255
        default 1

    config MM_EXPERIMENTAL_MESH_CHAN
        int "Experimental mesh S1G primary channel number"
        range 1 255
        default 27

    config MM_EXPERIMENTAL_MESH_PRI_1MHZ_LOC
        int "Experimental mesh primary 1 MHz channel location"
        range 0 1
        default 0

    config MM_EXPERIMENTAL_MESH_ID
        string "Experimental mesh ID (OpenWrt mesh_id)"
        default "halow-mesh"

    config MM_EXPERIMENTAL_MESH_KEY
        string "Experimental mesh SAE key (OpenWrt option key)"
        default "12345678"

    config MM_EXPERIMENTAL_MESH_BSSID
        string "Experimental mesh target BSSID (optional, xx:xx:xx:xx:xx:xx)"
        default ""

    config MM_EXPERIMENTAL_MESH_SCAN_DWELL_MS
        int "Experimental mesh internal scan dwell time (ms)"
        range 15 1000
        default 120

    config MM_EXPERIMENTAL_MESH_SCAN_HOME_DWELL_MS
        int "Experimental mesh internal scan home dwell time (ms)"
        range 0 1000
        default 0

    config MM_EXPERIMENTAL_MESH_FULL_SCAN_DWELL_MS
        int "Experimental mesh pre-scan dwell time (ms)"
        range 15 1000
        default 120

    config MM_EXPERIMENTAL_MESH_USE_SENSOR_STA
        bool "Use SENSOR STA type in experimental mesh"
        default n

    config MM_MESH_DEBUG_LOG
        bool "Enable mesh debug trace logs"
        default n
        help
            Enable verbose mesh debug trace printf output from the Morse Micro
            framework (mesh_trace, MESH_TRACE_FLOW, mesh_key).
            Disable to suppress all mesh debug prints for cleaner logs.

endif

endmenu

menu "HaLow Provisioning Configuration"

    config HALOW_HINT_KEEP_PERCENT
        int "HaLow hint channel keep ratio (%)"
        range 1 100
        default 100
        help
            Percentage of regulatory channels to keep in the fast-hint filtered
            channel list. 100 keeps all channels (no filtering). Lower values
            keep fewer channels nearest to the saved frequency hint.

    config HALOW_VERBOSE_CHANNEL_LOG
        bool "Verbose HaLow channel list logging"
        default n
        help
            Enable detailed logging of full channel lists. Disable to reduce
            UART log overhead and improve provisioning latency.

    config HALOW_HINT_USE_BSSID_LOCK
        bool "Use fast-hint BSSID lock on connect"
        default n
        help
            When enabled and fast hint contains a valid BSSID, lock the initial
            connection attempt to that BSSID for faster AP selection. If disabled,
            connection remains flexible across BSSID changes.

    config MM_EXPERIMENTAL_MESH_PREQ_INTERVAL_MS
        int "Periodic HWMP PREQ broadcast interval (ms, 0=disabled)"
        range 0 60000
        default 4000
        help
            Interval in milliseconds for broadcasting proactive HWMP PREQ
            frames.  This makes the ESP32 visible to remote mesh nodes and
            establishes HWMP forwarding paths so the mesh root can route
            IP traffic back to this node.  Set to 0 to disable.

endmenu
```
